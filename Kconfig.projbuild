## Kconfig.projbuild
```kconfig
menu "VR Controller Configuration"

    config VR_CONTROLLER_DEBUG
        bool "Enable debug logging"
        default y

    config VR_CONTROLLER_I2C_TOUCH_PORT
        int "I2C port for touch (AXS15231B)"
        default 0
        range 0 1

    config VR_CONTROLLER_I2C_IMU_PORT
        int "I2C port for IMU (QMI8658)"
        default 1
        range 0 1

    config VR_CONTROLLER_SPI_LCD_HOST
        int "SPI host for LCD"
        default 3
        range 1 3

    config VR_CONTROLLER_JOYSTICK_DEADZONE
        int "Joystick deadzone percentage (0-20)"
        default 5
        range 0 20

    config VR_CONTROLLER_SLEEP_TIMEOUT_S
        int "Sleep timeout in seconds (0=disabled)"
        default 30
        range 0 300

    config VR_CONTROLLER_AIR_MOUSE_SENSITIVITY
        int "Air mouse sensitivity (10-500)"
        default 150
        range 10 500

    config VR_CONTROLLER_GESTURE_THRESHOLD
        int "Gesture detection threshold (10-100)"
        default 30
        range 10 100

endmenu
```

## sdkconfig.defaults
```kconfig
CONFIG_IDF_TARGET="esp32s3"
CONFIG_ESPTOOLPY_FLASHSIZE_16MB=y
CONFIG_FREERTOS_HZ=1000
CONFIG_BT_ENABLED=y
CONFIG_BT_NIMBLE_ENABLED=y
CONFIG_BT_NIMBLE_MAX_CONNECTIONS=2
CONFIG_BT_NIMBLE_ROLE_PERIPHERAL=y
CONFIG_BT_BLE_42_FEATURES_SUPPORTED=y
CONFIG_BT_BLE_SMP_ENABLE=y
CONFIG_BT_NIMBLE_LOG_LEVEL_WARNING=y
CONFIG_BT_BTU_TASK_STACK_SIZE=4096
CONFIG_ESP_TASK_WDT_CHECK_IDLE_TASK_CPU0=y
CONFIG_SPIRAM=y
CONFIG_SPIRAM_MODE_QUAD=y
CONFIG_SPIRAM_SPEED_80M=y
CONFIG_LV_COLOR_DEPTH_16=y
CONFIG_LV_COLOR_16_SWAP=y
CONFIG_LV_FONT_MONTSERRAT_14=y
CONFIG_LV_FONT_MONTSERRAT_12=y
CONFIG_LV_FONT_MONTSERRAT_16=y
CONFIG_LV_FONT_MONTSERRAT_20=y
CONFIG_SPI_MASTER_IN_IRAM=y
CONFIG_SPI_MASTER_ISR_IN_IRAM=y
CONFIG_I2C_MASTER_IN_IRAM=y
```
